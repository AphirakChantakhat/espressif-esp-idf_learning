## Lab_5/main/Kconfig.projbuild
```kconfig
menu "Example Configuration"

config GPIO_OUT_PUT_0
    int "GPIO output pin #0"
    default 18
    help 
        set the GPIO pin for pin #0

config GPIO_OUT_PUT_1
    int "GPIO output pin #1"
    default 19
    help 
        set the GPIO pin for pin #1

config GPIO_INPUT_0
    int "GPIO output pin #1"
    default 16
    help 
        set the GPIO pin for pin #1

config GPIO_INPUT_1
    int "GPIO output pin #1"
    default 17
    help 
        set the GPIO pin for pin #1

config GPIO_INPUT_2
    int "GPIO output pin #1"
    default 5
    help 
        set the GPIO pin for pin #1

endmenu
```
